## conf/distro/mapio.conf
```bitbake
# Poky based
require conf/distro/poky.conf

# Distro description
DISTRO = "mapio"

# Systemd
INIT_MANAGER = "systemd"
DISTRO_FEATURES:append = " systemd"
DISTRO_FEATURES:append = " wifi bluetooth sdio rfkill usrmerge"
ROOT_HOME = "/home/root"

# Docker
DISTRO_FEATURES:append = " virtualization"
PREFERRED_PROVIDER_virtual/docker="docker-moby"

DISTRO_FEATURES:append = " rauc"
DISTRO_EXTRA_RDEPENDS:append = " ${@bb.utils.contains('DISTRO_FEATURES', 'rauc', 'u-boot-fw-utils', '', d)} "
DISTRO_EXTRA_RDEPENDS:append = " ${@bb.utils.contains('DISTRO_FEATURES', 'rauc', 'libubootenv', '', d)} "
DISTRO_EXTRA_RDEPENDS:append = " ${@bb.utils.contains('DISTRO_FEATURES', 'rauc', 'u-boot', '', d)} "
DISTRO_EXTRA_RDEPENDS:append = " ${@bb.utils.contains('DISTRO_FEATURES', 'rauc', 'rauc-conf', '', d)} "
DISTRO_EXTRA_RDEPENDS:append = " ${@bb.utils.contains('DISTRO_FEATURES', 'rauc', 'rauc', '', d)} "

# Hostname configuration
hostname:pn-base-files = "mapio"

# Remove uneeded features
DISTRO_FEATURES:remove = " \
        3g \
        alsa \
        nfc \
        nfs \
        pcmcia \
        ptest \
        pulseaudio \
        usbgadget \
        vulkan \
        wayland \
        x11 \
"

# https://github.com/RPi-Distro/firmware-nonfree/issues/29
LICENSE_FLAGS_ACCEPTED = "synaptics-killswitch"
```
